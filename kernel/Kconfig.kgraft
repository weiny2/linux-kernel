## kernel/Kconfig.kgraft
```kconfig
config HAVE_KGRAFT
	bool

config KGRAFT
	bool "kGraft infrastructure"
	depends on DYNAMIC_FTRACE_WITH_REGS
	depends on HAVE_KGRAFT
	help
	  Select this to enable kGraft live kernel patching. The
	  runtime penalty is nearly zero, so it is safe to say Y here
	  if you want the kernel to expose the API for live patching
	  to modules.
```

## kernel/Kconfig.svos
```kconfig
config SVOS
	bool "Enable SVOS kernel modifications"
	default n
	help
		Enable Intel internal-only SVOS kernel modifications for silicon validation

config SVOS_RAS_ERRORCORRECT
	depends on SVOS
	bool "Enable SVOS autocorrection of errors - RAS only!"
	default n
	help
		Enable automatic error correction - RAS only!

config SVFS_ACPI
	depends on SVOS && ACPI
	bool "Enable SVOS SVFS ACPI driver support"
	default n
	help
		Enable SVOS ACPI driver support for ACPI debug support
```
