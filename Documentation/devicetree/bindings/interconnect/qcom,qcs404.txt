## Documentation/devicetree/bindings/interconnect/qcom,qcs404.txt
```
Qualcomm QCS404 Network-On-Chip interconnect driver binding
-----------------------------------------------------------

Required properties :
- compatible : shall contain only one of the following:
			"qcom,qcs404-bimc"
			"qcom,qcs404-pcnoc"
			"qcom,qcs404-snoc"
- #interconnect-cells : should contain 1

Optional properties :
clocks : list of phandles and specifiers to all interconnect bus clocks
clock-names : clock names should include both "bus_clk" and "bus_a_clk"

Example:

rpm-glink {
	...
	rpm_requests: glink-channel {
		...
		bimc: interconnect@0 {
			compatible = "qcom,qcs404-bimc";
			#interconnect-cells = <1>;
			clock-names = "bus_clk", "bus_a_clk";
			clocks = <&rpmcc RPM_SMD_BIMC_CLK>,
				<&rpmcc RPM_SMD_BIMC_A_CLK>;
		};

		pnoc: interconnect@1 {
			compatible = "qcom,qcs404-pcnoc";
			#interconnect-cells = <1>;
			clock-names = "bus_clk", "bus_a_clk";
			clocks = <&rpmcc RPM_SMD_PNOC_CLK>,
				<&rpmcc RPM_SMD_PNOC_A_CLK>;
		};

		snoc: interconnect@2 {
			compatible = "qcom,qcs404-snoc";
			#interconnect-cells = <1>;
			clock-names = "bus_clk", "bus_a_clk";
			clocks = <&rpmcc RPM_SMD_SNOC_CLK>,
				<&rpmcc RPM_SMD_SNOC_A_CLK>;
		};
	};
};
```

## Documentation/devicetree/bindings/leds/leds-turris-omnia.txt
```
Bindings for LEDs on CZ.NIC's Turris Omnia

Required properties:
 - compatible :		Should be "cznic,turris-omnia-leds"
 - reg :		I2C slave address
 - #address-cells :	Should be 1
 - #size-cells :	Should be 0

LED sub-node properties:
 - reg :		Must be from 0x0 to 0xb, since there are 12 LEDs on this
			controller.
 - label :		(optional)
   see Documentation/devicetree/bindings/leds/common.txt
 - linux,default-trigger : (optional)
   see Documentation/devicetree/bindings/leds/common.txt

Example:

	led-controller@2b {
		compatible = "cznic,turris-omnia-leds";
		reg = <0x2b>;
		#address-cells = <1>;
		#size-cells = <0>;

		led@0 {
			reg = <0x0>;
			label = "userB";
			linux,default-trigger = "heartbeat";
		};

		led@1 {
			reg = <0x1>;
			label = "userA";
		};

		led@2 {
			reg = <0x2>;
			label = "pci3";
		};

		led@3 {
			reg = <0x3>;
			label = "pci2";
		};

		led@4 {
			reg = <0x4>;
			label = "pci1";
		};

		led@5 {
			reg = <0x5>;
			label = "wan";
		};

		led@6 {
			reg = <0x6>;
			label = "lan4";
		};

		led@7 {
			reg = <0x7>;
			label = "lan3";
		};

		led@8 {
			reg = <0x8>;
			label = "lan2";
		};

		led@9 {
			reg = <0x9>;
			label = "lan1";
		};

		led@a {
			reg = <0xa>;
			label = "lan0";
		};

		led@b {
			reg = <0xb>;
			label = "power";
		};
	};
```

## Documentation/devicetree/bindings/misc/intel,keembay-ipc.txt
```
Intel Keem Bay IPC
-----------------------------------------------------
This binding defines the IPC used on the Intel Keem Bay platform.

Required properties:
- compatible : "intel,keembay-ipc"
- memory-region: Reference to the reserved memory region used for IPC buffers.

Example:
	ipc {
		compatible = "intel,keembay-ipc";
		memory-region = <&css_ipc_reserved>, <&mss_ipc_reserved>;
	};
```

## drivers/block/nd/Kconfig
```kconfig
menuconfig ND_DEVICES
	bool "NVDIMM (Non-Volatile Memory Device) Support"
	help
	  Generic support for non-volatile memory devices including
	  ACPI-6-NFIT defined resources.  On platforms that define an
	  NFIT, or otherwise can discover NVDIMM resources, a libnd
	  bus is registered to advertise PMEM (persistent memory)
	  namespaces (/dev/pmemX) and BLK (sliding mmio window(s))
	  namespaces (/dev/ndX). A PMEM namespace refers to a memory
	  resource that may span multiple DIMMs and support DAX (see
	  CONFIG_DAX).  A BLK namespace refers to an NVDIMM control
	  region which exposes an mmio register set for windowed
	  access mode to non-volatile memory.

if ND_DEVICES

config LIBND
	tristate

config NFIT_TEST
	tristate "NFIT TEST: Manufactured NFIT for interface testing"
	default n
	depends on EXPERT
	depends on DMA_CMA
	depends on LIBND=m
	depends on ACPI_NFIT
	depends on m
	help
	  For development purposes register a manufactured
	  NFIT table to verify the resulting device model topology.
	  Note, this module arranges for ioremap_cache() to be
	  overridden locally to allow simulation of system-memory as an
	  io-memory-resource.

	  Note, this test expects to be able to find at least 256MB of
	  CMA space (CONFIG_CMA_SIZE_MBYTES, cma=) or it will fail to
	  load.

	  Say N unless you are doing development of the 'libnd' subsystem.

config BLK_DEV_PMEM
	tristate "PMEM: Persistent memory block device support"
	depends on LIBND
	default LIBND
	help
	  Memory ranges for PMEM are described by either an NFIT
	  (NVDIMM Firmware Interface Table, see CONFIG_NFIT_ACPI), a
	  non-standard OEM-specific E820 memory type (type-12, see
	  CONFIG_X86_PMEM_LEGACY), or it is manually specified by the
	  'memmap=nn[KMG]!ss[KMG]' kernel command line (see
	  Documentation/kernel-parameters.txt).  This driver converts
	  these persistent memory ranges into block devices that are
	  capable of DAX (direct-access) file system mappings.  See
	  Documentation/blockdev/nd.txt for more details.

	  Say Y if you want to use a NVDIMM described by ACPI, E820, etc...

config ND_BLK
	tristate "BLK: Block data window (aperture) device support"
	depends on LIBND
	default LIBND
	help
	  This driver performs I/O using a set of mmio windows on a
	  dimm.  The set of apertures will all access the one DIMM.
	  Multiple windows allow multiple threads to have a different
	  portions of the dimm open at one time.

	  Say Y if you want to use a NVDIMM with BLK-mode capability

config ND_BTT_DEVS
	bool

config ND_BTT
	tristate "BTT: Block Translation Table (atomic sector updates)"
	depends on LIBND 
	default LIBND
	select ND_BTT_DEVS

config ND_MAX_REGIONS
	int "Maximum number of regions supported by the sub-system"
	default 64
	---help---
	  A 'region' corresponds to an individual DIMM or an interleave
	  set of DIMMs.  A typical maximally configured system may have
	  up to 32 DIMMs.

	  Leave the default of 64 if you are unsure.

config ND_IOSTAT
	bool "LIBND: Enable iostat by default"
	default n
	---help---
	  Persistent memory i/o has very low latency to the point
	  where the overhead to measure statistics can dramatically
	  impact the relative performance of the driver.  Say y here
	  to trade off performance for statistics gathering that is
	  enabled by default.  These statistics can always be
	  enabled/disabled at run time via the 'iostat' attribute of
	  the block device's queue in sysfs.

	  If unsure, say N

endif
```

## drivers/crypto/thunderbay/Kconfig
```kconfig
config CRYPTO_DEV_THUNDERBAY_OCS_AES
	tristate "Support for Thunderbay OCS AES HW acceleration"
	help
	  Support for Thunderbay Offload and Crypto Subsystem (OCS)
	  AES hardware acceleration for use with Crypto API.

	  Provides OCS versions of ecb(aes), cbc(aes), ctr(aes),
	  and gcm(aes).

config CRYPTO_DEV_THUNDERBAY_OCS_HCU
	tristate "Support for Keembay OCS HCU HW acceleration"
	help
	  Support for Keembay Offload and Crypto Subsystem (OCS)
	  HCU (Hash Control Unit) hardware acceleration for use
	  with Crypto API.

	  Provides OCS versions of sha224, sha256, sha384 and sha512.
```

## drivers/infiniband/hw/hfi1/Kconfig
```kconfig
config INFINIBAND_HFI1
	tristate "Intel OPA Gen1 support"
	depends on 64BIT
	---help---
	This is a low-level driver for Intel OPA Gen1 adapter.
config HFI1_DEBUG_SDMA_ORDER
	bool "HFI1 SDMA Order debug"
	depends on INFINIBAND_HFI1
	default n
	---help---
	This is a debug flag to test for out of order
	sdma completions for unit testing
```

## drivers/infiniband/hw/hfi2/Kconfig
```kconfig
config INFINIBAND_HFI2
	tristate "Intel OPA Gen2 support"
	depends on X86_64 && INFINIBAND_RDMAVT && I2C
	depends on INTEL_IOMMU_SVM
	select CRC32
	select I2C_ALGOBIT
	---help---
	This is a low-level driver for Intel OPA Gen2 adapter.
config HFI2_STLNP
	bool "HFI2 support for native transport protocol"
	depends on INFINIBAND_HFI2
	default y
	---help---
	Setting this enables HFI2 native transport protocol
```

## drivers/infiniband/hw/wfr-lite/Kconfig
```kconfig
config INFINIBAND_WFR_LITE
	tristate "Intel WFR Lite debug HCA support"
	depends on 64BIT
	---help---
	This is a low-level driver for Intel PCIe QLE InfiniBand host
	channel adapters.  This driver does not support the Intel
	HyperTransport card (model QHT7140).
	This driver has been modified to act like a WFR driver for testing.
```

## drivers/infiniband/sw/rdmavt/Kconfig
```kconfig
config INFINIBAND_RDMAVT
	tristate "RDMA verbs transport library"
	depends on X86_64
	depends on PCI
	select DMA_VIRT_OPS
	---help---
	This is a common software verbs provider for RDMA networks.
```

## drivers/misc/dlb/Kconfig
```kconfig
# SPDX-License-Identifier: GPL-2.0-only

config INTEL_DLB
	tristate "Intel(R) Dynamic Load Balancer Driver"
	depends on 64BIT && PCI && X86
	help
	  This driver supports the Intel(R) Dynamic Load Balancer (DLB) device.

	  To compile this driver as a module, choose M here. The module
	  will be called dlb.

	  More information about the Intel(R) DLB as well as the Linux OS and
	  tools for DLB to use with this driver are available from <TODO>.
```

## drivers/misc/dlb2/Kconfig
```kconfig
comment "Intel Dynamic Load Balancer 2.0"

config INTEL_DLB2
	tristate "Intel(R) Dynamic Load Balancer 2.0 Driver"
	default m
	depends on 64BIT && PCI && X86 && PCI_IOV
	---help---
	  This driver supports the Intel(R) Dynamic Load Balancer 2.0 (dlb2)
	  family of devices.

	  To compile this driver as a module, choose M here. The module
	  will be called dlb.

          More information about the Intel(R) DLB 2.0 family as well as the
          Linux OS and tools for DLB to use with this driver are available from
          <TODO>.

config INTEL_DLB2_DATAPATH
	bool "Intel(R) Dynamic Load Balancer 2.0 kernel datapath support"
	default y
	depends on INTEL_DLB2
	---help---
	  Say Y if you want to enable the DLB 2.0 kernel datapath support in the
	  dlb2 driver. This exposes interfaces for kernel software to use the
	  device.

config INTEL_DLB2_SIOV
	bool "Intel(R) Dynamic Load Balancer 2.0 Scalable I/O Virtualization"
	default y
	depends on INTEL_DLB2
	depends on INTEL_IOMMU
	depends on VFIO
	depends on VFIO_MDEV
	depends on VFIO_MDEV_DEVICE
	depends on MSI_IMS

	---help---
	  Say Y if you want to enable Scalable I/O Virtualization support in
	  the dlb2 driver. If enabled, the driver is capable of creating
	  multiple virtual DLBs per physical device.
```

## drivers/misc/keembay-ipc/Kconfig
```kconfig
config KEEMBAY_IPC
	tristate "Support for KeemBay IPC"
	help
	  KeemBay IPC enables communication between KeemBay CPU Sub-System
	  (CSS) and KeemBay Media Sub-System (MSS).
```

## drivers/misc/vpusmm/Kconfig
```kconfig
# Copyright (C) 2019 Intel Corporation
# SPDX-License-Identifier: GPL-2.0-only

config VPUSMM
	tristate "Support for VPU Shared memory management"
	help
	  VPUSMM allocate/import DMABuf accessible to KeemBay VPU Sub-System
```

## drivers/misc/xbay/Kconfig
```kconfig
# SPDX-License-Identifier: GPL-2.0-only
# #
# # X-BAY devices
# #
#
menu "xbay devices"

source "drivers/misc/xbay/xlink-pcie/Kconfig"
endmenu
```

## drivers/misc/xbay/xlink-pcie/Kconfig
```kconfig
config XBAY_XLINK_PCIE_RH_DRIVER
	tristate "XBay XLink PCIe Remote Host driver"
	depends on PCI && (!XBAY_XLINK_PCIE_LH_DRIVER) && (XBAY_XLINK_PCIE_LH_DRIVER!=m)
	help
	  This option enables XLink PCIe Remote Host driver.

	  Choose M here to compile this driver as a module, name is mxlk.

config XBAY_XLINK_PCIE_LH_DRIVER
	tristate "XBay XLink PCIe Local Host driver"
	depends on PCI_ENDPOINT
	help
	  This option enables XLink PCIe Local Host driver.

	  Choose M here to compile this driver as a module, name is mxlk_ep.
```

## drivers/misc/xlink-core/Kconfig
```kconfig
config XLINK_CORE
	tristate "Support for XLINK CORE"
	depends on KEEMBAY_VPU_IPC
	help
	  XLINK CORE enables the communication/control Sub-System.

config XLINK_LOCAL_HOST
	tristate "Support for XLINK LOCAL HOST"
	depends on KEEMBAY_VPU_IPC
	help
	  XLINK LOCAL HOST enables local host functionality for
	  the communication/control Sub-System.
```

## drivers/misc/xlink-pcie/Kconfig
```kconfig
config XLINK_PCIE_RH_DRIVER
	tristate "XLink PCIe Remote Host driver"
	depends on PCI
	help
	  This option enables XLink PCIe Remote Host driver.

	  Choose M here to compile this driver as a module, name is mxlk.

config XLINK_PCIE_LH_DRIVER
	tristate "XLink PCIe Local Host driver"
	depends on PCI_ENDPOINT
	help
	  This option enables XLink PCIe Local Host driver.

	  Choose M here to compile this driver as a module, name is mxlk_ep.
```

## drivers/misc/xlink-secure/Kconfig
```kconfig
config XLINK_SECURE
	tristate "Support for XLINK SECURE"
	help
	  XLINK SECURE enables the communication/control Sub-System.

config XLINK_SECURE_LOCAL_HOST
	tristate "Support for XLINK SECURE LOCAL HOST"
	depends on XLINK_CORE && XLINK_IPC && XLINK_SECURE
	help
	  XLINK SECURE LOCAL HOST enables local host functionality for
	  the communication/control Sub-System.
```

## drivers/phy/intel/Kconfig
```kconfig
# SPDX-License-Identifier: GPL-2.0
#
# Phy drivers for Intel Lightning Mountain(LGM) and Intel Thunderbay platform
#
config PHY_INTEL_EMMC
	tristate "Intel EMMC PHY driver"
	select GENERIC_PHY
	help
	  Enable this to support the Intel EMMC PHY

config PHY_THUNDERBAY_EMMC
        tristate "Intel ThunderBay eMMC PHY driver"
        depends on OF && (ARM64 || COMPILE_TEST)
        select GENERIC_PHY
        help
          This option enables support for Intel ThunderBay SoC eMMC PHY.
```

## drivers/staging/hqmv2/Kconfig
```kconfig
comment "Intel Hardware Queue Manager V2"

config INTEL_HQMV2
	tristate "Intel(R) Hardware Queue Manager V2 Driver"
	default m
	depends on 64BIT && PCI && X86 && PCI_IOV
	---help---
	  This driver supports the Intel(R) Hardware Queue Manager V2 (HQMV2)
	  family of devices.

	  To compile this driver as a module, choose M here. The module
	  will be called hqm.

          More information about the Intel(R) HQMV2 family as well as the Linux
          OS and tools for HQM to use with this driver are available from
          <TODO>.

config INTEL_HQMV2_DATAPATH
	bool "Intel(R) Hardware Queue Manager V2 kernel datapath support"
	default y
	depends on INTEL_HQMV2
	---help---
	  Say Y if you want to enable the HQMV2 kernel datapath support in the
	  HQMV2 driver. This exposes interfaces for kernel software to use the
	  device.

config INTEL_HQMV2_SIOV
	bool "Intel(R) Hardware Queue Manager V2 Scalable I/O Virtualization"
	default n
	depends on INTEL_HQMV2
	depends on INTEL_IOMMU
	depends on VFIO
	depends on VFIO_MDEV
	depends on VFIO_MDEV_DEVICE

	---help---
	  Say Y if you want to enable Scalable I/O Virtualization support in
	  the HQMV2 driver. If enabled, the driver is capable of creating
	  multiple virtual HQMs per physical device.
```

## drivers/thunderbolt/Kconfig
```kconfig
# SPDX-License-Identifier: GPL-2.0-only
menuconfig USB4
	tristate "Unified support for USB4 and Thunderbolt"
	depends on PCI
	select APPLE_PROPERTIES if EFI_STUB && X86
	select CRC32
	select CRYPTO
	select CRYPTO_HASH
	select NVMEM
	help
	  USB4 and Thunderbolt driver. USB4 is the public speficiation
	  based on Thunderbolt 3 protocol. This driver is required if
	  you want to hotplug Thunderbolt and USB4 compliant devices on
	  Apple hardware or on PCs with Intel Falcon Ridge or newer.

	  To compile this driver a module, choose M here. The module will be
	  called thunderbolt.

config USB4_KUNIT_TEST
	bool "KUnit tests"
	depends on KUNIT=y
	depends on USB4=y

if USB4

config USB4_DEBUG
	bool "Debugging interface (EXPERIMENTAL)"
	help
	  Enable USB4 and Thunderbolt ioctl interface for querying and
	  debugging. This will create /dev/tb_dbgX device for each
	  Thunderbolt controller.

	  Only enable this if you know what you are doing! Never enable
	  this for production systems!

	  The interface is experimental and subject to change any time.
endif
```
