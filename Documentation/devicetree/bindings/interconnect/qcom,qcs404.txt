## fs/dmapi/Kconfig
```kconfig
config DMAPI
        tristate "DMAPI support"
        help
          The Data Management API is a system interface used to implement
          the interface defined in the X/Open document:
          "Systems Management: Data Storage Management (XDSM) API",
          dated February 1997.  This interface is used by hierarchical
          storage management systems.

          If any DMAPI-capable filesystem is built into the kernel, then
          DMAPI must also be built into the kernel.

config DMAPI_DEBUG
        bool "DMAPI debugging support"
        depends on DMAPI
        help
          If you don't know whether you need it, then you don't need it:
          answer N.
```

## fs/zonefs/Kconfig
```kconfig
config ZONEFS_FS
	tristate "zonefs filesystem support"
	depends on BLOCK
	depends on BLK_DEV_ZONED
	help
	  zonefs is a simple File System which exposes zones of a zoned block
	  device (e.g. host-managed or host-aware SMR disk drives) as files.

	  If unsure, say N.
```

## kernel/Kconfig.kgr
```kconfig
config HAVE_KGR
	bool

config KGR
	bool "Kgr infrastructure"
	depends on DYNAMIC_FTRACE_WITH_REGS
	depends on HAVE_KGR
	help
	 Select this to enable kGraft online kernel patching. The
	 runtime price is zero, so it is safe to say Y here.
```
